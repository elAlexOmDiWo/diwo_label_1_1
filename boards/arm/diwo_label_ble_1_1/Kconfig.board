## boards/arm/diwo_label_ble_1_1/Kconfig.board
```kconfig
# Copyright (c) 2022 Nordic Semiconductor ASA
# SPDX-License-Identifier: Apache-2.0

config BOARD_DIWO_LABEL_BLE_1_1
	bool "DiWo Label BLE 1_1"
	depends on SOC_NRF52832_QFAA
```

## boards/arm/diwo_label_ble_1_1/Kconfig.defconfig
```kconfig
# Copyright (c) 2022 Nordic Semiconductor ASA
# SPDX-License-Identifier: Apache-2.0

if BOARD_DIWO_LABEL_BLE_1_1

config BOARD
	default "diwo_label_ble_1_1"

config BT_CTLR
   default BT

endif
```

## boards/arm/diwo_label_ble_1_1/diwo_label_ble_1_1_defconfig
```kconfig
# Copyright (c) 2022 Nordic Semiconductor ASA
# SPDX-License-Identifier: Apache-2.0

CONFIG_SOC_SERIES_NRF52X=y
CONFIG_SOC_NRF52832_QFAA=y
CONFIG_BOARD_DIWO_LABEL_BLE_1_1=y

# Enable MPU
CONFIG_ARM_MPU=y

# Enable hardware stack protection
CONFIG_HW_STACK_PROTECTION=y
```
